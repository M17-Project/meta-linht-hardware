// SPDX-License-Identifier: (GPL-2.0+ OR MIT)
/*
 * Copyright 2023 Compulab
 */

/dts-v1/;
#include <dt-bindings/usb/pd.h>
#include "../freescale/imx93.dtsi"

#include "mcm-imx93.dtsi"
#include "sbc-mcm-imx93-uart.dtsi"
#include "sbc-mcm-imx93-i2c.dtsi"

#include "sbc-mcm-imx93.dtsi"

/ {
	model = "LinHT";
	compatible = "compulab,mcm-imx93", "fsl,imx93";
};
