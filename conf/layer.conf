## conf/layer.conf
```bitbake
# We have a conf and classes directory, add to BBPATH
BBPATH .= ":${LAYERDIR}"

# We have recipes-* directories, add to BBFILES
BBFILES += "${LAYERDIR}/recipes-*/*/*.bb \
            ${LAYERDIR}/recipes-*/*/*.bbappend"

BBFILE_COLLECTIONS += "meta-customhardware"
BBFILE_PATTERN_meta-customhardware = "^${LAYERDIR}/"
BBFILE_PRIORITY_meta-customhardware = "6"

LAYERDEPENDS_meta-customhardware = "core"
LAYERSERIES_COMPAT_meta-customhardware = "scarthgap"
```

## conf/machine/mcm-imx93.conf
```bitbake
require conf/machine/include/imx-base.inc
require conf/machine/include/arm/armv8-2a/tune-cortexa55.inc
require compulab-imx9.inc

MACHINE_FEATURES += "pci wifi bluetooth"
MACHINE_FEATURES:append:use-nxp-bsp = " optee jailhouse "

UBOOT_DEVICETREE_BASENAME = "mcm-imx93"
KERNEL_DEVICETREE_BASENAME = "sbc-${UBOOT_DEVICETREE_BASENAME}"
KERNEL_DEVICETREE = " \
    compulab/${KERNEL_DEVICETREE_BASENAME}.dtb \
"
UBOOT_DTB_NAME:mcm-imx93 = "${UBOOT_DEVICETREE_BASENAME}.dtb"

IMX_DEFAULT_BOOTLOADER:use-nxp-bsp = "u-boot-compulab"
IMX_DEFAULT_BOOTLOADER:use-mainline-bsp = "u-boot-compulab"

LOADADDR = ""
UBOOT_SUFFIX = "bin"
UBOOT_MAKE_TARGET = ""

SPL_BINARY = "spl/u-boot-spl.bin"

UBOOT_CONFIG_BASENAME = "mcm-imx93"

UBOOT_CONFIG ??= "sd"
UBOOT_CONFIG[sd]   = "${UBOOT_CONFIG_BASENAME}_defconfig,sdcard"
UBOOT_CONFIG[ecc]  = "${UBOOT_CONFIG_BASENAME}_inline_ecc_defconfig"
UBOOT_CONFIG[ld]   = "${UBOOT_CONFIG_BASENAME}_ld_defconfig"

# Set ATF platform name
ATF_PLATFORM = "imx93"

IMXBOOT_TARGETS = "flash_singleboot"

IMX_BOOT_SOC_TARGET = "iMX9"
IMX_BOOT_SEEK = "32"

# We have to disable SERIAL_CONSOLE due to auto-serial-console
SERIAL_CONSOLES = "115200;ttyLP0"

# Add additional firmware
MACHINE_FIRMWARE:append = " ethos-u-firmware linux-firmware-sd8997 "

DDR_FIRMWARE_NAME = " \
        lpddr4_dmem_1d_v202201.bin \
        lpddr4_dmem_2d_v202201.bin \
        lpddr4_imem_1d_v202201.bin \
        lpddr4_imem_2d_v202201.bin \
"

SECO_FIRMWARE_NAME:mx9-nxp-bsp = "mx93a0-ahab-container.img"

IMAGE_BOOT_FILES:append:use-nxp-bsp = " \
        imx93_m33_TCM_rpmsg_lite_pingpong_rtos_linux_remote.bin \
        imx93_m33_TCM_rpmsg_lite_str_echo_rtos.bin \
"
WKS_FILE_DEPENDS:append = " imx-m33-demos"

CL_RELEASE = "2.0"
```
